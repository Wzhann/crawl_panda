## sdkconfig.defaults
```kconfig
CONFIG_IDF_TARGET_ESP32S3=y
CONFIG_FREERTOS_HZ=1000
CONFIG_ESP_WIFI_SSID="CatRecorder"
CONFIG_ESP_WIFI_PASSWORD="12345678"
CONFIG_ESP_WIFI_CHANNEL=1
CONFIG_ESP_WIFI_MAX_CONN=4
CONFIG_LWIP_MAX_SOCKETS=16
```
